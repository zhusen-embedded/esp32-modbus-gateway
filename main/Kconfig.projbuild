## main/Kconfig.projbuild
```kconfig
menu "Modbus Gateway"

    config GW_DEVICE_ID
        string "Device ID (MQTT client id / topic prefix)"
        default "gw-0001"

    config GW_MQTT_URI
        string "MQTT broker URI"
        default "mqtts://broker.example.com:8883"

    config GW_MQTT_USER
        string "MQTT username"
        default "gateway"

    config GW_OTA_URL
        string "Firmware OTA URL (empty disables OTA)"
        default ""

    config GW_POLL_SLOT_MS
        int "Polling slot per slave (ms)"
        default 125
        help
            One slot per slave. 8 slaves x 125 ms = 1 s per full round.

    config GW_SLAVE_COUNT
        int "Number of RS485 slaves"
        default 8
        range 1 8

    config GW_REG_COUNT
        int "Holding registers read per slave"
        default 4
        range 1 8

endmenu
```

## sdkconfig.defaults
```kconfig
# 双 OTA 分区 + 独立 storage 分区放断网缓存
CONFIG_PARTITION_TABLE_CUSTOM=y
CONFIG_PARTITION_TABLE_CUSTOM_FILENAME="partitions.csv"
CONFIG_PARTITION_TABLE_FILENAME="partitions.csv"

CONFIG_ESPTOOLPY_FLASHSIZE_4MB=y

# MQTT over TLS 需要 mbedtls 证书校验
CONFIG_MBEDTLS_CERTIFICATE_BUNDLE=y

# 任务看门狗由各任务自己 reset，不喂 idle 任务
CONFIG_ESP_TASK_WDT_INIT=n

CONFIG_GW_DEVICE_ID="gw-0001"
CONFIG_GW_MQTT_URI="mqtts://broker.example.com:8883"
CONFIG_GW_MQTT_USER="gateway"
CONFIG_GW_POLL_SLOT_MS=125
CONFIG_GW_SLAVE_COUNT=8
CONFIG_GW_REG_COUNT=4
```
